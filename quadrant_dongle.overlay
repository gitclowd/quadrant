/*
 * Copyright (c) 2020 Pete Johanson
 *
 * SPDX-License-Identifier: MIT
 */

#include "quadrant.dtsi"

&kscan0 {
		col-gpios
			= <&xiao_d 1 GPIO_ACTIVE_HIGH>
			, <&xiao_d 6 GPIO_ACTIVE_HIGH> /* GPIO 2 broken */
			, <&xiao_d 3 GPIO_ACTIVE_HIGH>
			, <&xiao_d 4 GPIO_ACTIVE_HIGH>
			, <&xiao_d 5 GPIO_ACTIVE_HIGH>

			;
			
		row-gpios
			= <&xiao_d 10 (GPIO_ACTIVE_HIGH | GPIO_PULL_DOWN)>
			;
};

&default_transform {
    row-offset = <10>;
};

